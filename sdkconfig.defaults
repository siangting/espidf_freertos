## sdkconfig.defaults
```kconfig
# sdkconfig.defaults (放在與 platformio.ini 同一層)
CONFIG_ARDUINO_AS_COMPONENT=y
CONFIG_FREERTOS_HZ=1000

# no-affinity 實際值
CONFIG_FREERTOS_NO_AFFINITY=0xffffffff

# 把所有需要用到 FREERTOS_NO_AFFINITY 的 Kconfig symbol 都設成 0xFFFFFFFF
CONFIG_ESP_MAIN_TASK_AFFINITY=0xFFFFFFFF
CONFIG_ESP_TIMER_TASK_AFFINITY=0xFFFFFFFF
CONFIG_LWIP_TCPIP_TASK_AFFINITY=0xFFFFFFFF
CONFIG_FMB_PORT_TASK_AFFINITY=0xFFFFFFFF
CONFIG_MDNS_TASK_AFFINITY=0xFFFFFFFF
```
